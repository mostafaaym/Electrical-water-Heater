/*
 * EEPROM_Core.c
 *
 * Created: 9/4/2023 7:30:43 PM
 *  Author: abdel
 */ 


/**********************************************************************************************************************
 *  FILE DESCRIPTION
 *  -----------------------------------------------------------------------------------------------------------------*/
/**        \file  FileName.c
 *        \brief  
 *
 *      \details  
 *
 *
 *********************************************************************************************************************/

/**********************************************************************************************************************
 *  INCLUDES
 *********************************************************************************************************************/
#include "EEPROM_Core.h"

/**********************************************************************************************************************
*  LOCAL MACROS CONSTANT\FUNCTION
*********************************************************************************************************************/

/**********************************************************************************************************************
 *  LOCAL DATA 
 *********************************************************************************************************************/

/**********************************************************************************************************************
 *  GLOBAL DATA
 *********************************************************************************************************************/

/**********************************************************************************************************************
 *  LOCAL FUNCTION PROTOTYPES
 *********************************************************************************************************************/

/**********************************************************************************************************************
 *  LOCAL FUNCTIONS
 *********************************************************************************************************************/

/**********************************************************************************************************************
 *  GLOBAL FUNCTIONS
 *********************************************************************************************************************/


/******************************************************************************
* \Syntax          : Std_ReturnType FunctionName(AnyType parameterName)
* \Description     : Describe this service
*
* \Sync\Async      : Synchronous
* \Reentrancy      : Non Reentrant
* \Parameters (in) : parameterName   Parameter Description
* \Parameters (out): None
* \Return value:   : Std_ReturnType  E_OK
*                                    E_NOT_OK
*******************************************************************************/

Uint_8 EEPROM_read(Uint_16 addr)
{
	
	// Setup Address Register
	EEARL = (Uint_8) addr;
	EEARH = (Uint_8) (addr>>8);
	
	// Start Reading
	SET_BIT(EECR,EERE_PIN);
	
	// Return Data from Resister
	return EEDR;

}


/******************************************************************************
* \Syntax          : Std_ReturnType FunctionName(AnyType parameterName)
* \Description     : Describe this service
*
* \Sync\Async      : Synchronous
* \Reentrancy      : Non Reentrant
* \Parameters (in) : parameterName   Parameter Description
* \Parameters (out): None
* \Return value:   : Std_ReturnType  E_OK
*                                    E_NOT_OK
*******************************************************************************/

void EEPROM_write(Uint_16 addr, Uint_8 data){
	
	Uint_8 INT_EN=0;
	
	// Setup Address Register
	EEARL = (Uint_8)addr;
	EEARH = (Uint_8)(addr>>8);
	
	// Put Data in Data Register
	EEDR = data;
	
	// Disable Interrupts to work fine
	if( GET_BIT(SREG,SREG_PIN_GLOBAL_INT) == 1)
	{
		
		INT_EN = 1;
		CLR_BIT(SREG,SREG_PIN_GLOBAL_INT);
	}
	
	// Start Writing
	SET_BIT(EECR,EEMWE_PIN);
	SET_BIT(EECR,EEWE_PIN);
	
	while( GET_BIT(EECR,EEWE_PIN ) == 1);
	
	// Enable Interrupt again
	if (INT_EN==1)
	{
		SET_BIT(SREG,SREG_PIN_GLOBAL_INT);
	}
	
}



/**********************************************************************************************************************
 *  END OF FILE: FileName.c
 *********************************************************************************************************************/
